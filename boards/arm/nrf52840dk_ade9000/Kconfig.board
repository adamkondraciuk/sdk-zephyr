## boards/arm/nrf52840dk_ade9000/Kconfig.board
```kconfig
# nRF52840 DK ADE9000 board configuration

# Copyright (c) 2016 Nordic Semiconductor ASA
# SPDX-License-Identifier: Apache-2.0

config BOARD_NRF52840DK_ADE9000
	bool "nRF52840 DK ADE9000"
	depends on SOC_NRF52840_QIAA
```

## boards/arm/nrf52840dk_ade9000/Kconfig.defconfig
```kconfig
# nRF52840 DK ADE9000 board configuration

# Copyright (c) 2016 Nordic Semiconductor ASA
# SPDX-License-Identifier: Apache-2.0

if BOARD_NRF52840DK_ADE9000

config BOARD
	default "nrf52840dk_ade9000"

config BT_CTLR
	default BT

endif # BOARD_NRF52840DK_ADE9000
```

## dts/bindings/timer/nordic,nrf-grtc.yaml
```yaml
#
# Copyright (c) 2024 Nordic Semiconductor ASA
#
# SPDX-License-Identifier: Apache-2.0
#

description: Nordic GRTC (Global RTC)

compatible: "nordic,nrf-grtc"

include:
  - "base.yaml"
  - "nordic,split-channels.yaml"
  - "pinctrl-device.yaml"

properties:
  reg:
    required: true

  interrupts:
    required: true

  cc-num:
    description: Number of capture/compare channels
    type: int
    required: true

  pinctrl-0:
    required: false
```
