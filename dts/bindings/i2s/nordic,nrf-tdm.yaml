## dts/bindings/i2s/nordic,nrf-tdm.yaml
```yaml
# Copyright (c) 2024 Nordic Semiconductor ASA
# SPDX-License-Identifier: Apache-2.0

description: Nordic TDM (Time division multiplexed audio interface)

compatible: "nordic,nrf-tdm"

include: [i2s-controller.yaml, pinctrl-device.yaml, nordic-clockpin.yaml, "memory-region.yaml"]

properties:
  reg:
    required: true

  interrupts:
    required: true

  pinctrl-0:
    required: true

  pinctrl-names:
    required: true

  easydma-maxcnt-bits:
    type: int
    required: true
    description: |
      Maximum number of bits available in the EasyDMA MAXCNT register. This
      property must be set at SoC level DTS files.

  clock-source:
    type: string
    default: "PCLK32M"
    description: |
      Clock source to be used by the I2S peripheral for the master clock
      (MCK) generator. The generator is only needed when the I2S peripheral
      is operating in Master mode. The following options are available:
      - "PCLK32M": 32 MHz peripheral clock, synchronous to HFCLK
      - "ACLK": Audio PLL clock with configurable frequency (frequency for
        this clock must be set via the "hfclkaudio-frequency" property
        in the "nordic,nrf-clock" node); this clock source is only available
        in the nRF53 Series SoCs and it requires the use of HFXO
    enum:
      - "PCLK32M"
      - "ACLK"
```
